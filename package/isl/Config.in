## package/isl/Config.in
```kconfig
config BR2_PACKAGE_ISL
	bool "isl"
	select BR2_PACKAGE_GMP
	help
	  ISL is a library for manipulating sets and relations of integer
	  points bounded by linear constraints.

	  https://libisl.sourceforge.io/
	  
```
